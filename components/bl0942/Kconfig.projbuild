## components/bl0942/Kconfig.projbuild
```kconfig
menu "BL0942 Energy Monitor"

config BL0942_ENABLE
    bool "Enable BL0942 driver"
    default y
    help
        Enables the BL0942 component and its configuration options.

config ESP_BL0942_UART_PORT
    int "UART port (0/1/2)"
    depends on BL0942_ENABLE
    default 0 if IDF_TARGET_ESP32C2
    default 2 if IDF_TARGET_ESP32
    default 1 if IDF_TARGET_ESP32C3
    range 0 2
    help
        UART port used to communicate with the BL0942.

config ESP_BL0942_UART_TX_GPIO
    int "BL0942 TX -> ESP RX GPIO (BL0942 TX/SDO pin)"
    depends on BL0942_ENABLE
    default -1 if IDF_TARGET_ESP32C2
    default 17 if IDF_TARGET_ESP32
    default 4 if IDF_TARGET_ESP32C3
    range -1 39
    help
        GPIO used as UART RX on the ESP side (connected to BL0942 TX).
        Use -1 to keep the UART's default pins.

config ESP_BL0942_UART_RX_GPIO
    int "BL0942 RX -> ESP TX GPIO (BL0942 RX/SDI pin)"
    depends on BL0942_ENABLE
    default -1 if IDF_TARGET_ESP32C2
    default 16 if IDF_TARGET_ESP32
    default 5 if IDF_TARGET_ESP32C3
    range -1 39
    help
        GPIO used as UART TX on the ESP side (connected to BL0942 RX).
        Use -1 to keep the UART's default pins.

config BL0942_UART_BAUD
    int "BL0942 UART baudrate"
    depends on BL0942_ENABLE
    default 4800
    range 4800 38400
    help
        UART baudrate. Must match BL0942 MODE[9:8] and SCLK_BPS pin.

config BL0942_ADDRESS
    int "BL0942 UART address (A2:A1)"
    depends on BL0942_ENABLE
    default 0
    range 0 3
    help
        For SSOP10 devices this is always 0. For TSSOP14 multi-drop UART,
        this matches pins A2_NCS and A1.

config BL0942_VREF_V
    string "BL0942 Vref voltage (V)"
    depends on BL0942_ENABLE
    default "1.218"

config BL0942_SHUNT_UOHM
    int "Shunt value (micro-ohms)"
    depends on BL0942_ENABLE
    default 1000
    range 1 100000000

config BL0942_V_DIV_RATIO
    string "Voltage divider ratio (Vpin_rms / Vline_rms)"
    depends on BL0942_ENABLE
    default "0.00100"

config BL0942_SAMPLE_PERIOD_MS
    int "Sample period (ms)"
    depends on BL0942_ENABLE
    default 1000
    range 250 60000

config BL0942_VOLTAGE_CAL
    string "Voltage calibration multiplier"
    depends on BL0942_ENABLE
    default "1.000"

config BL0942_CURRENT_CAL
    string "Current calibration multiplier"
    depends on BL0942_ENABLE
    default "1.000"

config BL0942_POWER_CAL
    string "Power calibration multiplier"
    depends on BL0942_ENABLE
    default "1.000"

endmenu
```

## main/Kconfig.projbuild
```kconfig
menu "StudioPieters"

    comment "For more information visit www.studiopieters.nl"

    config ESP_SWITCH_GPIO
        int "Switch GPIO"
        default 5  if IDF_TARGET_ESP32
        default 5  if IDF_TARGET_ESP32C3
        range 0 39
        help
            GPIO for an external wall switch / toggle input.

    config ESP_RELAY_GPIO
        int "Relay GPIO"
        default 16  if IDF_TARGET_ESP32
        default 4  if IDF_TARGET_ESP32C3
        range 0 39
        help
            GPIO driving the relay transistor/driver.
            For ESP32: must be output-capable (0..33). Do NOT use GPIO6..11 (flash).

    config ESP_BUTTON_GPIO
        int "Button GPIO"
        default 23 if IDF_TARGET_ESP32
        # AUBESS ESP8684-WROOM-03 (ESP32-C3): button input on GPIO1
        default 1  if IDF_TARGET_ESP32C3
        range 0 39
        help
            Button input GPIO (active-low if using button_active_low).
            If using GPIO34..39 on ESP32: these pins are input-only and have NO internal pullups.

    config ESP_BLUE_LED_GPIO
        int "Blue LED GPIO"
        default 2  if IDF_TARGET_ESP32
        default 6 if IDF_TARGET_ESP32C3
        range 0 39
        help
            GPIO driving blue LED.
            Note: GPIO2 is a boot strap pin; OK on most devkits/onboard LEDs.

    config ESP_BL0942_UPDATE_PERIOD_MS
        int "BL0942 Update Period (ms)"
        default 1000
        range 250 60000
        help
            How often the BL0942 readings are sampled and pushed to HomeKit.
            Lower values give smoother graphs but increase CPU usage and HomeKit traffic.

    config ESP_SETUP_CODE
        string "HomeKit Setup Code"
        default "392-74-806"
        help
            If you want to change the HomeKit Setup Code, you can do that here (Note:  you need to make a new QR-CODE To make it work)

    config ESP_SETUP_ID
        string "HomeKit Setup ID"
        default "7M4N"
        help
            If you want to change the HomeKit Setup ID, you can do that here (Note: you need to make a new QR-CODE To make it work)

endmenu
```

## sdkconfig.defaults
```kconfig
#
# StudioPieters
#

# General Optimization
CONFIG_COMPILER_OPTIMIZATION_SIZE=y


# Binary Size Reduction
CONFIG_LOG_DEFAULT_LEVEL_ERROR=y

# IMPORTANT:
# This project must run on both ESP32-WROOM-32D and ESP8685-WROOM-03 (ESP32-C3).
# Both modules are commonly flashed/monitored via an external USB-UART adapter,
# so keep the serial console enabled on UART0.
CONFIG_ESP_CONSOLE_UART_DEFAULT=y
CONFIG_ESP_CONSOLE_UART_NUM=0
CONFIG_ESP_CONSOLE_UART_BAUDRATE=115200

# RAM Usage Minimization
# CONFIG_FREERTOS_IDLE_TASK_STACKSIZE=512
# CONFIG_FREERTOS_ISR_STACKSIZE=1536
CONFIG_HEAP_POISONING_DISABLED=y
CONFIG_HEAP_TRACING_OFF=y

#
# HomeKit
#
CONFIG_HOMEKIT_MAX_CLIENTS=16
CONFIG_HOMEKIT_SMALL=y
CONFIG_HOMEKIT_DEBUG=y
# end of HomeKit

#
# wolfSSL
#
CONFIG_WOLFSSL_APPLE_HOMEKIT=y
CONFIG_ESP_MAIN_TASK_STACK_SIZE=10500

#
# BL0942 calibration (AUBESS power monitor switch)
#
# PCB-verified network:
#   R_high = 1914 + 1914 = 1.91M + 1.91M = 3.82M
#   R_low  = RA1 || RA2 = 1k || 1k = 500R
#   => V_DIV_RATIO ~= R_low / (R_high + R_low) ~= 0.0001308
CONFIG_BL0942_V_DIV_RATIO="0.0002627"

# After setting the correct divider ratio, keep voltage calibration near 1.0.
# (Fine-trim in menuconfig if desired.)
CONFIG_BL0942_VOLTAGE_CAL="1.000"
```
